C     Include File:  BLOCK2.INC

      DATA (IRND(I,1),I=1,24)/5,2,8,7,7,6,9,7,1,5,8,0,
     &                        7,3,6,8,5,1,8,1,4,6,4,4/
      DATA (IRND(I,2),I=1,24)/0,6,6,4,0,1,3,0,4,5,9,5,
     &                        3,1,4,8,2,5,6,9,8,9,1,2/
      DATA (IRND(I,3),I=1,24)/4,0,8,4,1,3,0,3,2,8,6,2,
     &                        5,6,1,4,3,5,1,2,1,3,5,1/
      DATA (IRND(I,4),I=1,24)/0,0,2,3,5,6,0,2,0,1,1,7,
     &                        9,6,5,4,7,3,1,3,1,3,6,2/
      DATA (IRND(I,5),I=1,24)/9,8,1,4,6,9,6,9,3,2,2,3,
     &                        2,4,9,2,3,0,1,1,6,4,2,6/
      DATA (IRND(I,6),I=1,24)/0,7,9,7,6,0,2,6,2,2,9,0,
     &                        5,9,6,6,6,9,2,5,6,0,6,0/
      DATA (IRND(I,7),I=1,24)/2,7,4,9,7,0,3,8,4,8,7,6,
     &                        5,0,1,9,8,8,5,6,2,6,5,9/
      DATA (IRND(I,8),I=1,24)/3,5,2,9,1,9,9,5,4,4,3,1,
     &                        3,8,6,3,2,4,7,6,7,2,4,8/
      DATA (IRND(I,9),I=1,24)/9,0,0,8,0,3,7,8,4,8,5,1,
     &                        8,9,4,7,5,8,0,5,3,4,8,9/
      DATA (IRND(I,10),I=1,24)/5,7,4,9,2,9,8,8,0,6,5,7,
     &                         9,0,0,2,2,1,7,3,9,6,2,5/
      DATA (IRND(I,11),I=1,24)/4,8,7,8,7,8,6,5,6,9,1,4,
     &                         9,8,1,5,7,0,3,8,0,0,5,3/
      DATA (IRND(I,12),I=1,24)/2,3,8,0,1,2,2,6,7,5,2,3,
     &                         2,2,5,3,0,3,6,9,0,1,9,4/
      DATA (IRND(I,13),I=1,24)/3,2,7,3,8,4,1,7,5,7,6,5,
     &                         4,1,5,0,1,8,4,0,2,5,4,2/
      DATA (IRND(I,14),I=1,24)/8,7,2,4,6,0,6,8,4,4,2,1,
     &                         7,5,1,0,6,0,9,7,0,1,1,4/
      DATA (IRND(I,15),I=1,24)/4,6,2,4,9,4,3,6,1,1,6,4,
     &                         8,4,7,0,7,1,5,6,8,7,3,4/
      DATA (IRND(I,16),I=1,24)/0,3,1,3,8,6,6,2,6,1,5,6,
     &                         6,4,5,9,0,5,3,4,0,0,3,6/
      DATA (IRND(I,17),I=1,24)/1,2,3,8,7,1,4,5,8,6,0,9,
     &                         0,2,8,6,2,3,3,1,2,2,5,3/
      DATA (IRND(I,18),I=1,24)/4,3,3,7,9,6,3,2,7,6,1,1,
     &                         5,9,5,9,3,3,9,4,3,5,7,0/
      DATA (IRND(I,19),I=1,24)/1,1,9,0,7,2,6,6,1,5,8,3,
     &                         4,4,5,7,8,2,4,8,1,5,2,0/

      DATA (IRND(I,20),I=1,24)/3,7,1,8,1,7,9,2,4,9,2,0,
     &                         7,4,6,7,5,3,1,9,3,8,3,2/
      DATA (IRND(I,21),I=1,24)/3,4,3,4,1,5,3,1,9,4,6,9,
     &                         3,0,4,2,2,8,0,3,0,1,2,3/
      DATA (IRND(I,22),I=1,24)/6,5,4,8,9,6,1,6,2,8,2,7,
     &                         1,1,9,8,3,0,9,1,4,9,5,7/
      DATA (IRND(I,23),I=1,24)/4,1,4,4,3,5,3,1,9,3,0,8,
     &                         4,3,4,7,6,9,8,5,1,1,1,4/
      DATA (IRND(I,24),I=1,24)/0,3,1,2,3,6,1,7,2,8,1,2,
     &                         3,1,7,2,2,6,6,6,9,9,7,3/
      DATA (IRND(I,25),I=1,24)/4,6,8,9,5,9,0,5,8,6,5,2,
     &                         7,6,6,4,0,5,5,4,2,4,1,4/
      DATA (IRND(I,26),I=1,24)/6,9,2,2,8,0,7,0,7,8,6,0,
     &                         0,6,0,4,9,5,8,2,0,0,8,2/
      DATA (IRND(I,27),I=1,24)/5,6,5,5,2,5,1,4,5,6,7,4,
     &                         0,1,8,0,2,5,0,0,2,5,0,0/
      DATA (IRND(I,28),I=1,24)/1,4,1,8,6,1,0,3,3,8,8,0,
     &                         2,9,5,6,5,2,2,4,1,5,2,2/
      DATA (IRND(I,29),I=1,24)/1,6,9,5,2,8,7,8,7,3,7,4,
     &                         7,5,9,8,4,1,7,1,3,6,8,2/
      DATA (IRND(I,30),I=1,24)/9,6,1,7,4,2,6,9,1,6,6,3,
     &                         8,4,2,7,6,5,8,7,2,5,5,2/
      DATA (IRND(I,31),I=1,24)/8,2,6,5,7,1,9,6,0,8,2,0,
     &                         1,8,3,0,2,3,0,3,5,2,0,7/
      DATA (IRND(I,32),I=1,24)/7,2,1,3,1,0,3,0,4,8,0,0,
     &                         8,3,0,0,2,6,0,3,9,6,5,6/
      DATA (IRND(I,33),I=1,24)/6,9,7,9,3,7,0,0,9,0,5,0,
     &                         7,0,6,4,2,8,2,1,7,4,3,7/
      DATA (IRND(I,34),I=1,24)/5,9,0,2,0,0,4,6,8,7,9,4,
     &                         2,2,6,1,1,9,0,6,7,2,7,9/
      DATA (IRND(I,35),I=1,24)/1,1,0,9,6,2,1,3,8,0,9,7,
     &                         7,1,9,6,0,6,9,8,0,8,6,2/
      DATA (IRND(I,36),I=1,24)/0,3,6,6,3,0,3,2,4,9,6,6,
     &                         9,0,8,9,7,1,9,6,3,6,8,1/
      DATA (IRND(I,37),I=1,24)/2,7,4,0,2,1,8,3,8,2,2,0,
     &                         8,3,9,6,6,6,2,5,3,6,1,1/
      DATA (IRND(I,38),I=1,24)/2,9,8,2,5,4,6,8,8,7,2,5,
     &                         6,4,5,5,8,7,2,9,4,9,7,8/

      DATA (IRND(I,39),I=1,24)/4,5,9,5,4,6,5,9,5,8,0,7,
     &                         8,6,6,7,2,3,9,1,7,3,0,6/
      DATA (IRND(I,40),I=1,24)/3,8,0,1,5,2,0,1,4,5,5,8,
     &                         3,0,1,2,6,1,1,3,0,9,9,5/
      DATA (IRND(I,41),I=1,24)/9,3,4,5,0,9,5,3,1,4,5,6,
     &                         8,3,7,9,2,8,4,1,9,8,1,5/
      DATA (IRND(I,42),I=1,24)/0,7,8,6,1,0,7,2,7,9,5,5,
     &                         2,6,9,9,8,1,5,7,5,0,0,8/
      DATA (IRND(I,43),I=1,24)/3,3,8,5,3,6,7,6,0,6,9,1,
     &                         2,5,2,8,2,6,9,4,6,9,2,9/
      DATA (IRND(I,44),I=1,24)/8,9,3,1,8,6,1,4,3,5,8,5,
     &                         3,1,4,3,4,9,8,0,3,3,2,0/
      DATA (IRND(I,45),I=1,24)/4,6,0,0,2,9,4,8,7,7,2,8,
     &                         6,1,9,7,7,0,3,1,5,2,2,7/
      DATA (IRND(I,46),I=1,24)/7,6,6,4,2,1,5,8,0,2,0,9,
     &                         2,6,2,0,8,0,0,9,5,8,4,8/
      DATA (IRND(I,47),I=1,24)/9,5,6,8,5,3,9,4,2,8,9,6,
     &                         7,9,0,4,6,3,6,8,8,3,5,8/
      DATA (IRND(I,48),I=1,24)/0,6,5,8,5,1,9,5,2,5,9,8,
     &                         2,8,8,6,3,3,8,2,4,6,7,0/
      DATA (IRND(I,49),I=1,24)/7,7,7,8,1,4,4,8,2,2,3,1,
     &                         0,1,5,0,3,7,4,8,2,7,6,9/
      DATA (IRND(I,50),I=1,24)/3,3,2,0,3,2,4,1,8,5,4,7,
     &                         6,6,1,1,8,1,6,4,2,3,1,2/
      DATA (IRND(I,51),I=1,24)/2,7,8,5,2,7,6,9,6,1,7,6,
     &                         2,4,8,0,2,1,9,5,9,0,0,4/
      DATA (IRND(I,52),I=1,24)/4,8,2,2,8,2,8,0,8,0,6,8,
     &                         5,7,2,2,2,5,6,8,3,7,6,0/
      DATA (IRND(I,53),I=1,24)/0,4,4,0,8,4,9,4,8,1,8,0,
     &                         3,8,8,6,7,5,2,0,0,3,9,1/
      DATA (IRND(I,54),I=1,24)/0,2,4,3,5,7,9,5,6,5,3,0,
     &                         0,9,0,1,0,0,9,6,6,4,2,7/
      DATA (IRND(I,55),I=1,24)/7,6,6,5,8,1,0,3,5,6,4,3,
     &                         5,9,9,7,6,8,8,8,5,9,1,1/
      DATA (IRND(I,56),I=1,24)/8,9,2,1,9,7,6,7,6,0,7,0,
     &                         0,4,9,5,2,5,2,1,4,0,8,8/
      DATA (IRND(I,57),I=1,24)/5,2,4,6,9,4,7,6,3,5,4,4,
     &                         2,5,0,6,1,8,7,8,9,5,9,8/

      DATA (IRND(I,58),I=1,24)/2,1,7,6,9,8,7,7,9,3,5,3,
     &                         2,9,9,9,0,5,2,3,0,9,2,1/
      DATA (IRND(I,59),I=1,24)/3,3,0,1,4,3,0,4,1,0,3,3,
     &                         4,9,6,3,6,7,1,4,3,9,6,9/
      DATA (IRND(I,60),I=1,24)/3,3,2,1,8,2,9,6,2,8,8,1,
     &                         9,9,8,9,5,9,3,3,3,3,7,4/
      DATA (IRND(I,61),I=1,24)/9,3,3,4,4,9,0,9,7,1,1,2,
     &                         5,0,0,2,4,0,7,2,9,8,4,3/
      DATA (IRND(I,62),I=1,24)/3,2,3,7,9,8,3,2,7,8,1,9,
     &                         0,0,7,7,6,3,7,0,6,2,5,9/
      DATA (IRND(I,63),I=1,24)/4,9,7,0,2,0,1,3,1,8,4,0,
     &                         7,2,7,3,8,8,7,2,3,4,3,1/
      DATA (IRND(I,64),I=1,24)/4,4,0,1,4,1,9,5,0,8,3,5,
     &                         9,8,4,5,3,7,3,8,0,2,8,1/
      DATA (IRND(I,65),I=1,24)/0,4,4,1,4,5,4,9,2,5,2,4,
     &                         6,1,5,3,5,3,0,9,1,4,6,4/
      DATA (IRND(I,66),I=1,24)/8,6,5,0,1,5,0,5,0,2,0,7,
     &                         3,6,2,4,6,6,5,3,2,4,9,4/
      DATA (IRND(I,67),I=1,24)/6,2,2,0,6,8,2,4,4,8,5,4,
     &                         7,9,5,6,3,8,8,4,5,0,1,8/
      DATA (IRND(I,68),I=1,24)/3,7,2,6,4,6,9,4,6,0,9,0,
     &                         6,8,4,8,9,9,0,0,2,1,1,2/
      DATA (IRND(I,69),I=1,24)/3,4,3,4,1,5,3,1,9,4,6,9,
     &                         3,0,4,2,2,8,0,3,0,1,2,3/
      DATA (IRND(I,70),I=1,24)/6,5,4,8,9,6,1,6,2,8,2,7,
     &                         1,1,9,8,3,0,9,1,4,9,5,7/
      DATA (IRND(I,71),I=1,24)/4,1,4,4,3,5,3,1,9,3,0,8,
     &                         4,3,4,7,6,9,8,5,1,1,1,4/
      DATA (IRND(I,72),I=1,24)/0,3,1,2,3,6,1,7,2,8,1,2,
     &                         3,1,7,2,2,6,6,6,9,9,7,3/
      DATA (IRND(I,73),I=1,24)/4,6,8,9,5,9,0,5,8,6,5,2,
     &                         7,6,6,4,0,5,5,4,2,4,1,4/
      DATA (IRND(I,74),I=1,24)/6,9,2,2,8,0,7,0,7,8,6,0,
     &                         0,6,0,4,9,5,8,2,0,0,8,2/
      DATA (IRND(I,75),I=1,24)/5,6,5,5,2,5,1,4,5,6,7,4,
     &                         0,1,8,0,2,5,0,0,2,5,0,0/
      DATA (IRND(I,76),I=1,24)/1,4,1,8,6,1,0,3,3,8,8,0,
     &                         2,9,5,6,5,2,2,4,1,5,2,2/

      DATA (IRND(I,77),I=1,24)/1,6,9,5,2,8,7,8,7,3,7,4,
     &                         7,5,9,8,4,1,7,1,3,6,8,2/
      DATA (IRND(I,78),I=1,24)/9,6,1,7,4,2,6,9,1,6,6,3,
     &                         8,4,2,7,6,5,8,7,2,5,5,2/
      DATA (IRND(I,79),I=1,24)/8,2,6,5,7,1,9,6,0,8,2,0,
     &                         1,8,3,0,2,3,0,3,5,2,0,7/
      DATA (IRND(I,80),I=1,24)/7,2,1,3,1,0,3,0,4,8,0,0,
     &                         8,3,0,0,2,6,0,3,9,6,5,6/
      DATA (IRND(I,81),I=1,24)/6,9,7,9,3,7,0,0,9,0,5,0,
     &                         7,0,6,4,2,8,2,1,7,4,3,7/
      DATA (IRND(I,82),I=1,24)/5,9,0,2,0,0,4,6,8,7,9,4,
     &                         2,2,6,1,1,9,0,6,7,2,7,9/
      DATA (IRND(I,83),I=1,24)/1,1,0,9,6,2,1,3,8,0,9,7,
     &                         7,1,9,6,0,6,9,8,0,8,6,2/
      DATA (IRND(I,84),I=1,24)/0,3,6,6,3,0,3,2,4,9,6,6,
     &                         9,0,8,9,7,1,9,6,3,6,8,1/
      DATA (IRND(I,85),I=1,24)/2,7,4,0,2,1,8,3,8,2,2,0,
     &                         8,3,9,6,6,6,2,5,3,6,1,1/
      DATA (IRND(I,86),I=1,24)/2,9,8,2,5,4,6,8,8,7,2,5,
     &                         6,4,5,5,8,7,2,9,4,9,7,8/
      DATA (IRND(I,87),I=1,24)/4,5,9,5,4,6,5,9,5,8,0,7,
     &                         8,6,6,7,2,3,9,1,7,3,0,6/
      DATA (IRND(I,88),I=1,24)/3,8,0,1,5,2,0,1,4,5,5,8,
     &                         3,0,1,2,6,1,1,3,0,9,9,5/
      DATA (IRND(I,89),I=1,24)/9,3,4,5,0,9,5,3,1,4,5,6,
     &                         8,3,7,9,2,8,4,1,9,8,1,5/
      DATA (IRND(I,90),I=1,24)/0,7,8,6,1,0,7,2,7,9,5,5,
     &                         2,6,9,9,8,1,5,7,5,0,0,8/
      DATA (IRND(I,91),I=1,24)/3,3,8,5,3,6,7,6,0,6,9,1,
     &                         2,5,2,8,2,6,9,4,6,9,2,9/
      DATA (IRND(I,92),I=1,24)/8,9,3,1,8,6,1,4,3,5,8,5,
     &                         3,1,4,3,4,9,8,0,3,3,2,0/
      DATA (IRND(I,93),I=1,24)/4,6,0,0,2,9,4,8,7,7,2,8,
     &                         6,1,9,7,7,0,3,1,5,2,2,7/
      DATA (IRND(I,94),I=1,24)/7,6,6,4,2,1,5,8,0,2,0,9,
     &                         2,6,2,0,8,0,0,9,5,8,4,8/
      DATA (IRND(I,95),I=1,24)/9,5,6,8,5,3,9,4,2,8,9,6,
     &                         7,9,0,4,6,3,6,8,8,3,5,8/

      DATA (IRND(I,96),I=1,24)/0,6,5,8,5,1,9,5,2,5,9,8,
     &                         2,8,8,6,3,3,8,2,4,6,7,0/
      DATA (IRND(I,97),I=1,24)/7,7,7,8,1,4,4,8,2,2,3,1,
     &                         0,1,5,0,3,7,4,8,2,7,6,9/
      DATA (IRND(I,98),I=1,24)/3,3,2,0,3,2,4,1,8,5,4,7,
     &                         6,6,1,1,8,1,6,4,2,3,1,2/
      DATA (IRND(I,99),I=1,24)/2,7,8,5,2,7,6,9,6,1,7,6,
     &                         2,4,8,0,2,1,9,5,9,0,0,4/
      DATA (IRND(I,100),I=1,24)/4,8,2,2,8,2,8,0,8,0,6,8,
     &                          5,7,2,2,2,5,6,8,3,7,6,0/
      DATA (IRND(I,101),I=1,24)/0,4,4,0,8,4,9,4,8,1,8,0,
     &                          3,8,8,6,7,5,2,0,0,3,9,1/
      DATA (IRND(I,102),I=1,24)/0,2,4,3,5,7,9,5,6,5,3,0,
     &                          0,9,0,1,0,0,9,6,6,4,2,7/
      DATA (IRND(I,103),I=1,24)/7,6,6,5,8,1,0,3,5,6,4,3,
     &                          5,9,9,7,6,8,8,8,5,9,1,1/
      DATA (IRND(I,104),I=1,24)/8,9,2,1,9,7,6,7,6,0,7,0,
     &                          0,4,9,5,2,5,2,1,4,0,8,8/
      DATA (IRND(I,105),I=1,24)/5,2,4,6,9,4,7,6,3,5,4,4,
     &                          2,5,0,6,1,8,7,8,9,5,9,8/
      DATA (IRND(I,106),I=1,24)/2,1,7,6,9,8,7,7,9,3,5,3,
     &                          2,9,9,9,0,5,2,3,0,9,2,1/
      DATA (IRND(I,107),I=1,24)/3,3,0,1,4,3,0,4,1,0,3,3,
     &                          4,9,6,3,6,7,1,4,3,9,6,9/
      DATA (IRND(I,108),I=1,24)/3,3,2,1,8,2,9,6,2,8,8,1,
     &                          9,9,8,9,5,9,3,3,3,3,7,4/
      DATA (IRND(I,109),I=1,24)/9,3,3,4,4,9,0,9,7,1,1,2,
     &                          5,0,0,2,4,0,7,2,9,8,4,3/
      DATA (IRND(I,110),I=1,24)/3,2,3,7,9,8,3,2,7,8,1,9,
     &                          0,0,7,7,6,3,7,0,6,2,5,9/
      DATA (IRND(I,111),I=1,24)/4,9,7,0,2,0,1,3,1,8,4,0,
     &                          7,2,7,3,8,8,7,2,3,4,3,1/
      DATA (IRND(I,112),I=1,24)/4,4,0,1,4,1,9,5,0,8,3,5,
     &                          9,8,4,5,3,7,3,8,0,2,8,1/
      DATA (IRND(I,113),I=1,24)/0,4,4,1,4,5,4,9,2,5,2,4,
     &                          6,1,5,3,5,3,0,9,1,4,6,4/
      DATA (IRND(I,114),I=1,24)/8,6,5,0,1,5,0,5,0,2,0,7,
     &                          3,6,2,4,6,6,5,3,2,4,9,4/

      DATA (IRND(I,115),I=1,24)/6,2,2,0,6,8,2,4,4,8,5,4,
     &                         7,9,5,6,3,8,8,4,5,0,1,8/
      DATA (IRND(I,116),I=1,24)/3,7,2,6,4,6,9,4,6,0,9,0,
     &                          6,8,4,8,9,9,0,0,2,1,1,2/
      DATA (IRND(I,117),I=1,24)/3,4,3,4,1,5,3,1,9,4,6,9,
     &                          3,0,4,2,2,8,0,3,0,1,2,3/
      DATA (IRND(I,118),I=1,24)/6,5,4,8,9,6,1,6,2,8,2,7,
     &                          1,1,9,8,3,0,9,1,4,9,5,7/
      DATA (IRND(I,119),I=1,24)/4,1,4,4,3,5,3,1,9,3,0,8,
     &                          4,3,4,7,6,9,8,5,1,1,1,4/
      DATA (IRND(I,120),I=1,24)/0,3,1,2,3,6,1,7,2,8,1,2,
     &                          3,1,7,2,2,6,6,6,9,9,7,3/
      DATA (IRND(I,121),I=1,24)/4,6,8,9,5,9,0,5,8,6,5,2,
     &                          7,6,6,4,0,5,5,4,2,4,1,4/
      DATA (IRND(I,122),I=1,24)/6,9,2,2,8,0,7,0,7,8,6,0,
     &                          0,6,0,4,9,5,8,2,0,0,8,2/
      DATA (IRND(I,123),I=1,24)/5,6,5,5,2,5,1,4,5,6,7,4,
     &                          0,1,8,0,2,5,0,0,2,5,0,0/
      DATA (IRND(I,124),I=1,24)/1,4,1,8,6,1,0,3,3,8,8,0,
     &                          2,9,5,6,5,2,2,4,1,5,2,2/
      DATA (IRND(I,125),I=1,24)/1,6,9,5,2,8,7,8,7,3,7,4,
     &                          7,5,9,8,4,1,7,1,3,6,8,2/
      DATA (IRND(I,126),I=1,24)/9,6,1,7,4,2,6,9,1,6,6,3,
     &                          8,4,2,7,6,5,8,7,2,5,5,2/
      DATA (IRND(I,127),I=1,24)/8,2,6,5,7,1,9,6,0,8,2,0,
     &                          1,8,3,0,2,3,0,3,5,2,0,7/
      DATA (IRND(I,128),I=1,24)/7,2,1,3,1,0,3,0,4,8,0,0,
     &                          8,3,0,0,2,6,0,3,9,6,5,6/
      DATA (IRND(I,129),I=1,24)/6,9,7,9,3,7,0,0,9,0,5,0,
     &                          7,0,6,4,2,8,2,1,7,4,3,7/
      DATA (IRND(I,130),I=1,24)/5,9,0,2,0,0,4,6,8,7,9,4,
     &                          2,2,6,1,1,9,0,6,7,2,7,9/
      DATA (IRND(I,131),I=1,24)/1,1,0,9,6,2,1,3,8,0,9,7,
     &                          7,1,9,6,0,6,9,8,0,8,6,2/
      DATA (IRND(I,132),I=1,24)/0,3,6,6,3,0,3,2,4,9,6,6,
     &                          9,0,8,9,7,1,9,6,3,6,8,1/
      DATA (IRND(I,133),I=1,24)/2,7,4,0,2,1,8,3,8,2,2,0,
     &                          8,3,9,6,6,6,2,5,3,6,1,1/

      DATA (IRND(I,134),I=1,24)/2,9,8,2,5,4,6,8,8,7,2,5,
     &                          6,4,5,5,8,7,2,9,4,9,7,8/
      DATA (IRND(I,135),I=1,24)/4,5,9,5,4,6,5,9,5,8,0,7,
     &                          8,6,6,7,2,3,9,1,7,3,0,6/
      DATA (IRND(I,136),I=1,24)/3,8,0,1,5,2,0,1,4,5,5,8,
     &                          3,0,1,2,6,1,1,3,0,9,9,5/
      DATA (IRND(I,137),I=1,24)/9,3,4,5,0,9,5,3,1,4,5,6,
     &                          8,3,7,9,2,8,4,1,9,8,1,5/
      DATA (IRND(I,138),I=1,24)/0,7,8,6,1,0,7,2,7,9,5,5,
     &                          2,6,9,9,8,1,5,7,5,0,0,8/
      DATA (IRND(I,139),I=1,24)/3,3,8,5,3,6,7,6,0,6,9,1,
     &                          2,5,2,8,2,6,9,4,6,9,2,9/
      DATA (IRND(I,140),I=1,24)/8,9,3,1,8,6,1,4,3,5,8,5,
     &                          3,1,4,3,4,9,8,0,3,3,2,0/
      DATA (IRND(I,141),I=1,24)/4,6,0,0,2,9,4,8,7,7,2,8,
     &                          6,1,9,7,7,0,3,1,5,2,2,7/
      DATA (IRND(I,142),I=1,24)/7,6,6,4,2,1,5,8,0,2,0,9,
     &                          2,6,2,0,8,0,0,9,5,8,4,8/
      DATA (IRND(I,143),I=1,24)/9,5,6,8,5,3,9,4,2,8,9,6,
     &                          7,9,0,4,6,3,6,8,8,3,5,8/
      DATA (IRND(I,144),I=1,24)/0,6,5,8,5,1,9,5,2,5,9,8,
     &                          2,8,8,6,3,3,8,2,4,6,7,0/
      DATA (IRND(I,145),I=1,24)/7,7,7,8,1,4,4,8,2,2,3,1,
     &                          0,1,5,0,3,7,4,8,2,7,6,9/
      DATA (IRND(I,146),I=1,24)/3,3,2,0,3,2,4,1,8,5,4,7,
     &                          6,6,1,1,8,1,6,4,2,3,1,2/
      DATA (IRND(I,147),I=1,24)/2,7,8,5,2,7,6,9,6,1,7,6,
     &                          2,4,8,0,2,1,9,5,9,0,0,4/
      DATA (IRND(I,148),I=1,24)/4,8,2,2,8,2,8,0,8,0,6,8,
     &                          5,7,2,2,2,5,6,8,3,7,6,0/
      DATA (IRND(I,149),I=1,24)/0,4,4,0,8,4,9,4,8,1,8,0,
     &                          3,8,8,6,7,5,2,0,0,3,9,1/
      DATA (IRND(I,150),I=1,24)/0,2,4,3,5,7,9,5,6,5,3,0,
     &                          0,9,0,1,0,0,9,6,6,4,2,7/
      DATA (IRND(I,151),I=1,24)/7,6,6,5,8,1,0,3,5,6,4,3,
     &                          5,9,9,7,6,8,8,8,5,9,1,1/
      DATA (IRND(I,152),I=1,24)/8,9,2,1,9,7,6,7,6,0,7,0,
     &                          0,4,9,5,2,5,2,1,4,0,8,8/

      DATA (IRND(I,153),I=1,24)/5,2,4,6,9,4,7,6,3,5,4,4,
     &                          2,5,0,6,1,8,7,8,9,5,9,8/
      DATA (IRND(I,154),I=1,24)/2,1,7,6,9,8,7,7,9,3,5,3,
     &                          2,9,9,9,0,5,2,3,0,9,2,1/
      DATA (IRND(I,155),I=1,24)/3,3,0,1,4,3,0,4,1,0,3,3,
     &                          4,9,6,3,6,7,1,4,3,9,6,9/
      DATA (IRND(I,156),I=1,24)/3,3,2,1,8,2,9,6,2,8,8,1,
     &                          9,9,8,9,5,9,3,3,3,3,7,4/
      DATA (IRND(I,157),I=1,24)/9,3,3,4,4,9,0,9,7,1,1,2,
     &                          5,0,0,2,4,0,7,2,9,8,4,3/
      DATA (IRND(I,158),I=1,24)/3,2,3,7,9,8,3,2,7,8,1,9,
     &                          0,0,7,7,6,3,7,0,6,2,5,9/
      DATA (IRND(I,159),I=1,24)/4,9,7,0,2,0,1,3,1,8,4,0,
     &                          7,2,7,3,8,8,7,2,3,4,3,1/
      DATA (IRND(I,160),I=1,24)/4,4,0,1,4,1,9,5,0,8,3,5,
     &                          9,8,4,5,3,7,3,8,0,2,8,1/
      DATA (IRND(I,161),I=1,24)/0,4,4,1,4,5,4,9,2,5,2,4,
     &                          6,1,5,3,5,3,0,9,1,4,6,4/
      DATA (IRND(I,162),I=1,24)/8,6,5,0,1,5,0,5,0,2,0,7,
     &                          3,6,2,4,6,6,5,3,2,4,9,4/
      DATA (IRND(I,163),I=1,24)/6,2,2,0,6,8,2,4,4,8,5,4,
     &                          7,9,5,6,3,8,8,4,5,0,1,8/
      DATA (IRND(I,164),I=1,24)/3,7,2,6,4,6,9,4,6,0,9,0,
     &                          6,8,4,8,9,9,0,0,2,1,1,2/
      DATA (IRND(I,165),I=1,24)/3,4,3,4,1,5,3,1,9,4,6,9,
     &                          3,0,4,2,2,8,0,3,0,1,2,3/
      DATA (IRND(I,166),I=1,24)/6,5,4,8,9,6,1,6,2,8,2,7,
     &                          1,1,9,8,3,0,9,1,4,9,5,7/
      DATA (IRND(I,167),I=1,24)/4,1,4,4,3,5,3,1,9,3,0,8,
     &                          4,3,4,7,6,9,8,5,1,1,1,4/
      DATA (IRND(I,168),I=1,24)/0,3,1,2,3,6,1,7,2,8,1,2,
     &                          3,1,7,2,2,6,6,6,9,9,7,3/
      DATA (IRND(I,169),I=1,24)/4,6,8,9,5,9,0,5,8,6,5,2,
     &                          7,6,6,4,0,5,5,4,2,4,1,4/
      DATA (IRND(I,170),I=1,24)/6,9,2,2,8,0,7,0,7,8,6,0,
     &                          0,6,0,4,9,5,8,2,0,0,8,2/
      DATA (IRND(I,171),I=1,24)/5,6,5,5,2,5,1,4,5,6,7,4,
     &                          0,1,8,0,2,5,0,0,2,5,0,0/

      DATA (IRND(I,172),I=1,24)/1,4,1,8,6,1,0,3,3,8,8,0,
     &                          2,9,5,6,5,2,2,4,1,5,2,2/
      DATA (IRND(I,173),I=1,24)/1,6,9,5,2,8,7,8,7,3,7,4,
     &                          7,5,9,8,4,1,7,1,3,6,8,2/
      DATA (IRND(I,174),I=1,24)/9,6,1,7,4,2,6,9,1,6,6,3,
     &                          8,4,2,7,6,5,8,7,2,5,5,2/
      DATA (IRND(I,175),I=1,24)/8,2,6,5,7,1,9,6,0,8,2,0,
     &                          1,8,3,0,2,3,0,3,5,2,0,7/
      DATA (IRND(I,176),I=1,24)/7,2,1,3,1,0,3,0,4,8,0,0,
     &                          8,3,0,0,2,6,0,3,9,6,5,6/
      DATA (IRND(I,177),I=1,24)/6,9,7,9,3,7,0,0,9,0,5,0,
     &                          7,0,6,4,2,8,2,1,7,4,3,7/
      DATA (IRND(I,178),I=1,24)/5,9,0,2,0,0,4,6,8,7,9,4,
     &                          2,2,6,1,1,9,0,6,7,2,7,9/
      DATA (IRND(I,179),I=1,24)/1,1,0,9,6,2,1,3,8,0,9,7,
     &                          7,1,9,6,0,6,9,8,0,8,6,2/
      DATA (IRND(I,180),I=1,24)/0,3,6,6,3,0,3,2,4,9,6,6,
     &                          9,0,8,9,7,1,9,6,3,6,8,1/
      DATA (IRND(I,181),I=1,24)/2,7,4,0,2,1,8,3,8,2,2,0,
     &                          8,3,9,6,6,6,2,5,3,6,1,1/
      DATA (IRND(I,182),I=1,24)/2,9,8,2,5,4,6,8,8,7,2,5,
     &                          6,4,5,5,8,7,2,9,4,9,7,8/
      DATA (IRND(I,183),I=1,24)/4,5,9,5,4,6,5,9,5,8,0,7,
     &                          8,6,6,7,2,3,9,1,7,3,0,6/
      DATA (IRND(I,184),I=1,24)/3,8,0,1,5,2,0,1,4,5,5,8,
     &                          3,0,1,2,6,1,1,3,0,9,9,5/
      DATA (IRND(I,185),I=1,24)/9,3,4,5,0,9,5,3,1,4,5,6,
     &                          8,3,7,9,2,8,4,1,9,8,1,5/
      DATA (IRND(I,186),I=1,24)/0,7,8,6,1,0,7,2,7,9,5,5,
     &                          2,6,9,9,8,1,5,7,5,0,0,8/
      DATA (IRND(I,187),I=1,24)/3,3,8,5,3,6,7,6,0,6,9,1,
     &                          2,5,2,8,2,6,9,4,6,9,2,9/
      DATA (IRND(I,188),I=1,24)/8,9,3,1,8,6,1,4,3,5,8,5,
     &                          3,1,4,3,4,9,8,0,3,3,2,0/
      DATA (IRND(I,189),I=1,24)/4,6,0,0,2,9,4,8,7,7,2,8,
     &                          6,1,9,7,7,0,3,1,5,2,2,7/
      DATA (IRND(I,190),I=1,24)/7,6,6,4,2,1,5,8,0,2,0,9,
     &                          2,6,2,0,8,0,0,9,5,8,4,8/

      DATA (IRND(I,191),I=1,24)/9,5,6,8,5,3,9,4,2,8,9,6,
     &                          7,9,0,4,6,3,6,8,8,3,5,8/
      DATA (IRND(I,192),I=1,24)/0,6,5,8,5,1,9,5,2,5,9,8,
     &                          2,8,8,6,3,3,8,2,4,6,7,0/
      DATA (IRND(I,193),I=1,24)/7,7,7,8,1,4,4,8,2,2,3,1,
     &                          0,1,5,0,3,7,4,8,2,7,6,9/
      DATA (IRND(I,194),I=1,24)/3,3,2,0,3,2,4,1,8,5,4,7,
     &                          6,6,1,1,8,1,6,4,2,3,1,2/
      DATA (IRND(I,195),I=1,24)/2,7,8,5,2,7,6,9,6,1,7,6,
     &                          2,4,8,0,2,1,9,5,9,0,0,4/
      DATA (IRND(I,196),I=1,24)/4,8,2,2,8,2,8,0,8,0,6,8,
     &                          5,7,2,2,2,5,6,8,3,7,6,0/
      DATA (IRND(I,197),I=1,24)/0,4,4,0,8,4,9,4,8,1,8,0,
     &                          3,8,8,6,7,5,2,0,0,3,9,1/
      DATA (IRND(I,198),I=1,24)/0,2,4,3,5,7,9,5,6,5,3,0,
     &                          0,9,0,1,0,0,9,6,6,4,2,7/
      DATA (IRND(I,199),I=1,24)/7,6,6,5,8,1,0,3,5,6,4,3,
     &                          5,9,9,7,6,8,8,8,5,9,1,1/
      DATA (IRND(I,200),I=1,24)/8,9,2,1,9,7,6,7,6,0,7,0,
     &                          0,4,9,5,2,5,2,1,4,0,8,8/
      DATA (IRND(I,201),I=1,24)/5,2,4,6,9,4,7,6,3,5,4,4,
     &                          2,5,0,6,1,8,7,8,9,5,9,8/
      DATA (IRND(I,202),I=1,24)/2,1,7,6,9,8,7,7,9,3,5,3,
     &                          2,9,9,9,0,5,2,3,0,9,2,1/
      DATA (IRND(I,203),I=1,24)/3,3,0,1,4,3,0,4,1,0,3,3,
     &                          4,9,6,3,6,7,1,4,3,9,6,9/
      DATA (IRND(I,204),I=1,24)/3,3,2,1,8,2,9,6,2,8,8,1,
     &                          9,9,8,9,5,9,3,3,3,3,7,4/
      DATA (IRND(I,205),I=1,24)/9,3,3,4,4,9,0,9,7,1,1,2,
     &                          5,0,0,2,4,0,7,2,9,8,4,3/
      DATA (IRND(I,206),I=1,24)/3,2,3,7,9,8,3,2,7,8,1,9,
     &                          0,0,7,7,6,3,7,0,6,2,5,9/
      DATA (IRND(I,207),I=1,24)/4,9,7,0,2,0,1,3,1,8,4,0,
     &                          7,2,7,3,8,8,7,2,3,4,3,1/
      DATA (IRND(I,208),I=1,24)/4,4,0,1,4,1,9,5,0,8,3,5,
     &                          9,8,4,5,3,7,3,8,0,2,8,1/
      DATA (IRND(I,209),I=1,24)/0,4,4,1,4,5,4,9,2,5,2,4,
     &                          6,1,5,3,5,3,0,9,1,4,6,4/

      DATA (IRND(I,210),I=1,24)/8,6,5,0,1,5,0,5,0,2,0,7,
     &                          3,6,2,4,6,6,5,3,2,4,9,4/
      DATA (IRND(I,211),I=1,24)/6,2,2,0,6,8,2,4,4,8,5,4,
     &                          7,9,5,6,3,8,8,4,5,0,1,8/
      DATA (IRND(I,212),I=1,24)/3,7,2,6,4,6,9,4,6,0,9,0,
     &                          6,8,4,8,9,9,0,0,2,1,1,2/
      DATA (IRND(I,213),I=1,24)/3,4,3,4,1,5,3,1,9,4,6,9,
     &                          3,0,4,2,2,8,0,3,0,1,2,3/
      DATA (IRND(I,214),I=1,24)/6,5,4,8,9,6,1,6,2,8,2,7,
     &                          1,1,9,8,3,0,9,1,4,9,5,7/
      DATA (IRND(I,215),I=1,24)/4,1,4,4,3,5,3,1,9,3,0,8,
     &                          4,3,4,7,6,9,8,5,1,1,1,4/
      DATA (IRND(I,216),I=1,24)/0,3,1,2,3,6,1,7,2,8,1,2,
     &                          3,1,7,2,2,6,6,6,9,9,7,3/
      DATA (IRND(I,217),I=1,24)/4,6,8,9,5,9,0,5,8,6,5,2,
     &                          7,6,6,4,0,5,5,4,2,4,1,4/
      DATA (IRND(I,218),I=1,24)/6,9,2,2,8,0,7,0,7,8,6,0,
     &                          0,6,0,4,9,5,8,2,0,0,8,2/
      DATA (IRND(I,219),I=1,24)/5,6,5,5,2,5,1,4,5,6,7,4,
     &                          0,1,8,0,2,5,0,0,2,5,0,0/
      DATA (IRND(I,220),I=1,24)/1,4,1,8,6,1,0,3,3,8,8,0,
     &                          2,9,5,6,5,2,2,4,1,5,2,2/
      DATA (IRND(I,221),I=1,24)/1,6,9,5,2,8,7,8,7,3,7,4,
     &                          7,5,9,8,4,1,7,1,3,6,8,2/
      DATA (IRND(I,222),I=1,24)/9,6,1,7,4,2,6,9,1,6,6,3,
     &                          8,4,2,7,6,5,8,7,2,5,5,2/
      DATA (IRND(I,223),I=1,24)/8,2,6,5,7,1,9,6,0,8,2,0,
     &                          1,8,3,0,2,3,0,3,5,2,0,7/
      DATA (IRND(I,224),I=1,24)/7,2,1,3,1,0,3,0,4,8,0,0,
     &                          8,3,0,0,2,6,0,3,9,6,5,6/
      DATA (IRND(I,225),I=1,24)/6,9,7,9,3,7,0,0,9,0,5,0,
     &                          7,0,6,4,2,8,2,1,7,4,3,7/
      DATA (IRND(I,226),I=1,24)/5,9,0,2,0,0,4,6,8,7,9,4,
     &                          2,2,6,1,1,9,0,6,7,2,7,9/
      DATA (IRND(I,227),I=1,24)/1,1,0,9,6,2,1,3,8,0,9,7,
     &                          7,1,9,6,0,6,9,8,0,8,6,2/
      DATA (IRND(I,228),I=1,24)/0,3,6,6,3,0,3,2,4,9,6,6,
     &                          9,0,8,9,7,1,9,6,3,6,8,1/

      DATA (IRND(I,229),I=1,24)/2,7,4,0,2,1,8,3,8,2,2,0,
     &                          8,3,9,6,6,6,2,5,3,6,1,1/
      DATA (IRND(I,230),I=1,24)/2,9,8,2,5,4,6,8,8,7,2,5,
     &                          6,4,5,5,8,7,2,9,4,9,7,8/
      DATA (IRND(I,231),I=1,24)/4,5,9,5,4,6,5,9,5,8,0,7,
     &                          8,6,6,7,2,3,9,1,7,3,0,6/
      DATA (IRND(I,232),I=1,24)/3,8,0,1,5,2,0,1,4,5,5,8,
     &                          3,0,1,2,6,1,1,3,0,9,9,5/
      DATA (IRND(I,233),I=1,24)/9,3,4,5,0,9,5,3,1,4,5,6,
     &                          8,3,7,9,2,8,4,1,9,8,1,5/
      DATA (IRND(I,234),I=1,24)/0,7,8,6,1,0,7,2,7,9,5,5,
     &                          2,6,9,9,8,1,5,7,5,0,0,8/
      DATA (IRND(I,235),I=1,24)/3,3,8,5,3,6,7,6,0,6,9,1,
     &                          2,5,2,8,2,6,9,4,6,9,2,9/
      DATA (IRND(I,236),I=1,24)/8,9,3,1,8,6,1,4,3,5,8,5,
     &                          3,1,4,3,4,9,8,0,3,3,2,0/
      DATA (IRND(I,237),I=1,24)/4,6,0,0,2,9,4,8,7,7,2,8,
     &                          6,1,9,7,7,0,3,1,5,2,2,7/
      DATA (IRND(I,238),I=1,24)/7,6,6,4,2,1,5,8,0,2,0,9,
     &                          2,6,2,0,8,0,0,9,5,8,4,8/
      DATA (IRND(I,239),I=1,24)/9,5,6,8,5,3,9,4,2,8,9,6,
     &                          7,9,0,4,6,3,6,8,8,3,5,8/
      DATA (IRND(I,240),I=1,24)/0,6,5,8,5,1,9,5,2,5,9,8,
     &                          2,8,8,6,3,3,8,2,4,6,7,0/
      DATA (IRND(I,241),I=1,24)/7,7,7,8,1,4,4,8,2,2,3,1,
     &                          0,1,5,0,3,7,4,8,2,7,6,9/
      DATA (IRND(I,242),I=1,24)/3,3,2,0,3,2,4,1,8,5,4,7,
     &                          6,6,1,1,8,1,6,4,2,3,1,2/
      DATA (IRND(I,243),I=1,24)/2,7,8,5,2,7,6,9,6,1,7,6,
     &                          2,4,8,0,2,1,9,5,9,0,0,4/
      DATA (IRND(I,244),I=1,24)/4,8,2,2,8,2,8,0,8,0,6,8,
     &                          5,7,2,2,2,5,6,8,3,7,6,0/
      DATA (IRND(I,245),I=1,24)/0,4,4,0,8,4,9,4,8,1,8,0,
     &                          3,8,8,6,7,5,2,0,0,3,9,1/
      DATA (IRND(I,246),I=1,24)/0,2,4,3,5,7,9,5,6,5,3,0,
     &                          0,9,0,1,0,0,9,6,6,4,2,7/
      DATA (IRND(I,247),I=1,24)/7,6,6,5,8,1,0,3,5,6,4,3,
     &                          5,9,9,7,6,8,8,8,5,9,1,1/

      DATA (IRND(I,248),I=1,24)/8,9,2,1,9,7,6,7,6,0,7,0,
     &                          0,4,9,5,2,5,2,1,4,0,8,8/
      DATA (IRND(I,249),I=1,24)/5,2,4,6,9,4,7,6,3,5,4,4,
     &                          2,5,0,6,1,8,7,8,9,5,9,8/
      DATA (IRND(I,250),I=1,24)/2,1,7,6,9,8,7,7,9,3,5,3,
     &                          2,9,9,9,0,5,2,3,0,9,2,1/
      DATA (IRND(I,251),I=1,24)/3,3,0,1,4,3,0,4,1,0,3,3,
     &                          4,9,6,3,6,7,1,4,3,9,6,9/
      DATA (IRND(I,252),I=1,24)/3,3,2,1,8,2,9,6,2,8,8,1,
     &                          9,9,8,9,5,9,3,3,3,3,7,4/
      DATA (IRND(I,253),I=1,24)/9,3,3,4,4,9,0,9,7,1,1,2,
     &                          5,0,0,2,4,0,7,2,9,8,4,3/
      DATA (IRND(I,254),I=1,24)/3,2,3,7,9,8,3,2,7,8,1,9,
     &                          0,0,7,7,6,3,7,0,6,2,5,9/
      DATA (IRND(I,255),I=1,24)/4,9,7,0,2,0,1,3,1,8,4,0,
     &                          7,2,7,3,8,8,7,2,3,4,3,1/
      DATA (IRND(I,256),I=1,24)/4,4,0,1,4,1,9,5,0,8,3,5,
     &                          9,8,4,5,3,7,3,8,0,2,8,1/
      DATA (IRND(I,257),I=1,24)/0,4,4,1,4,5,4,9,2,5,2,4,
     &                          6,1,5,3,5,3,0,9,1,4,6,4/
      DATA (IRND(I,258),I=1,24)/8,6,5,0,1,5,0,5,0,2,0,7,
     &                          3,6,2,4,6,6,5,3,2,4,9,4/
      DATA (IRND(I,259),I=1,24)/6,2,2,0,6,8,2,4,4,8,5,4,
     &                          7,9,5,6,3,8,8,4,5,0,1,8/
      DATA (IRND(I,260),I=1,24)/3,7,2,6,4,6,9,4,6,0,9,0,
     &                          6,8,4,8,9,9,0,0,2,1,1,2/
      DATA (IRND(I,261),I=1,24)/3,4,3,4,1,5,3,1,9,4,6,9,
     &                          3,0,4,2,2,8,0,3,0,1,2,3/
      DATA (IRND(I,262),I=1,24)/6,5,4,8,9,6,1,6,2,8,2,7,
     &                          1,1,9,8,3,0,9,1,4,9,5,7/
      DATA (IRND(I,263),I=1,24)/4,1,4,4,3,5,3,1,9,3,0,8,
     &                          4,3,4,7,6,9,8,5,1,1,1,4/
      DATA (IRND(I,264),I=1,24)/0,3,1,2,3,6,1,7,2,8,1,2,
     &                          3,1,7,2,2,6,6,6,9,9,7,3/
      DATA (IRND(I,265),I=1,24)/4,6,8,9,5,9,0,5,8,6,5,2,
     &                          7,6,6,4,0,5,5,4,2,4,1,4/
      DATA (IRND(I,266),I=1,24)/6,9,2,2,8,0,7,0,7,8,6,0,
     &                          0,6,0,4,9,5,8,2,0,0,8,2/

      DATA (IRND(I,267),I=1,24)/5,6,5,5,2,5,1,4,5,6,7,4,
     &                          0,1,8,0,2,5,0,0,2,5,0,0/
      DATA (IRND(I,268),I=1,24)/1,4,1,8,6,1,0,3,3,8,8,0,
     &                          2,9,5,6,5,2,2,4,1,5,2,2/
      DATA (IRND(I,269),I=1,24)/1,6,9,5,2,8,7,8,7,3,7,4,
     &                          7,5,9,8,4,1,7,1,3,6,8,2/
      DATA (IRND(I,270),I=1,24)/9,6,1,7,4,2,6,9,1,6,6,3,
     &                          8,4,2,7,6,5,8,7,2,5,5,2/
      DATA (IRND(I,271),I=1,24)/8,2,6,5,7,1,9,6,0,8,2,0,
     &                          1,8,3,0,2,3,0,3,5,2,0,7/
      DATA (IRND(I,272),I=1,24)/7,2,1,3,1,0,3,0,4,8,0,0,
     &                          8,3,0,0,2,6,0,3,9,6,5,6/
      DATA (IRND(I,273),I=1,24)/6,9,7,9,3,7,0,0,9,0,5,0,
     &                          7,0,6,4,2,8,2,1,7,4,3,7/
      DATA (IRND(I,274),I=1,24)/5,9,0,2,0,0,4,6,8,7,9,4,
     &                          2,2,6,1,1,9,0,6,7,2,7,9/
      DATA (IRND(I,275),I=1,24)/1,1,0,9,6,2,1,3,8,0,9,7,
     &                          7,1,9,6,0,6,9,8,0,8,6,2/
      DATA (IRND(I,276),I=1,24)/0,3,6,6,3,0,3,2,4,9,6,6,
     &                          9,0,8,9,7,1,9,6,3,6,8,1/
      DATA (IRND(I,277),I=1,24)/2,7,4,0,2,1,8,3,8,2,2,0,
     &                          8,3,9,6,6,6,2,5,3,6,1,1/
      DATA (IRND(I,278),I=1,24)/2,9,8,2,5,4,6,8,8,7,2,5,
     &                          6,4,5,5,8,7,2,9,4,9,7,8/
      DATA (IRND(I,279),I=1,24)/4,5,9,5,4,6,5,9,5,8,0,7,
     &                          8,6,6,7,2,3,9,1,7,3,0,6/
      DATA (IRND(I,280),I=1,24)/3,8,0,1,5,2,0,1,4,5,5,8,
     &                          3,0,1,2,6,1,1,3,0,9,9,5/
      DATA (IRND(I,281),I=1,24)/9,3,4,5,0,9,5,3,1,4,5,6,
     &                          8,3,7,9,2,8,4,1,9,8,1,5/
      DATA (IRND(I,282),I=1,24)/0,7,8,6,1,0,7,2,7,9,5,5,
     &                          2,6,9,9,8,1,5,7,5,0,0,8/
      DATA (IRND(I,283),I=1,24)/3,3,8,5,3,6,7,6,0,6,9,1,
     &                          2,5,2,8,2,6,9,4,6,9,2,9/
      DATA (IRND(I,284),I=1,24)/8,9,3,1,8,6,1,4,3,5,8,5,
     &                          3,1,4,3,4,9,8,0,3,3,2,0/
      DATA (IRND(I,285),I=1,24)/4,6,0,0,2,9,4,8,7,7,2,8,
     &                          6,1,9,7,7,0,3,1,5,2,2,7/

      DATA (IRND(I,286),I=1,24)/7,6,6,4,2,1,5,8,0,2,0,9,
     &                          2,6,2,0,8,0,0,9,5,8,4,8/
      DATA (IRND(I,287),I=1,24)/9,5,6,8,5,3,9,4,2,8,9,6,
     &                          7,9,0,4,6,3,6,8,8,3,5,8/
      DATA (IRND(I,288),I=1,24)/0,6,5,8,5,1,9,5,2,5,9,8,
     &                          2,8,8,6,3,3,8,2,4,6,7,0/
      DATA (IRND(I,289),I=1,24)/7,7,7,8,1,4,4,8,2,2,3,1,
     &                          0,1,5,0,3,7,4,8,2,7,6,9/
      DATA (IRND(I,290),I=1,24)/3,3,2,0,3,2,4,1,8,5,4,7,
     &                          6,6,1,1,8,1,6,4,2,3,1,2/
      DATA (IRND(I,291),I=1,24)/2,7,8,5,2,7,6,9,6,1,7,6,
     &                          2,4,8,0,2,1,9,5,9,0,0,4/
      DATA (IRND(I,292),I=1,24)/4,8,2,2,8,2,8,0,8,0,6,8,
     &                          5,7,2,2,2,5,6,8,3,7,6,0/
      DATA (IRND(I,293),I=1,24)/0,4,4,0,8,4,9,4,8,1,8,0,
     &                          3,8,8,6,7,5,2,0,0,3,9,1/
      DATA (IRND(I,294),I=1,24)/0,2,4,3,5,7,9,5,6,5,3,0,
     &                          0,9,0,1,0,0,9,6,6,4,2,7/
      DATA (IRND(I,295),I=1,24)/7,6,6,5,8,1,0,3,5,6,4,3,
     &                          5,9,9,7,6,8,8,8,5,9,1,1/
      DATA (IRND(I,296),I=1,24)/8,9,2,1,9,7,6,7,6,0,7,0,
     &                          0,4,9,5,2,5,2,1,4,0,8,8/
      DATA (IRND(I,297),I=1,24)/5,2,4,6,9,4,7,6,3,5,4,4,
     &                          2,5,0,6,1,8,7,8,9,5,9,8/
      DATA (IRND(I,298),I=1,24)/2,1,7,6,9,8,7,7,9,3,5,3,
     &                          2,9,9,9,0,5,2,3,0,9,2,1/
      DATA (IRND(I,299),I=1,24)/3,3,0,1,4,3,0,4,1,0,3,3,
     &                          4,9,6,3,6,7,1,4,3,9,6,9/
      DATA (IRND(I,300),I=1,24)/3,3,2,1,8,2,9,6,2,8,8,1,
     &                          9,9,8,9,5,9,3,3,3,3,7,4/
      DATA (IRND(I,301),I=1,24)/9,3,3,4,4,9,0,9,7,1,1,2,
     &                          5,0,0,2,4,0,7,2,9,8,4,3/
      DATA (IRND(I,302),I=1,24)/3,2,3,7,9,8,3,2,7,8,1,9,
     &                          0,0,7,7,6,3,7,0,6,2,5,9/
      DATA (IRND(I,303),I=1,24)/4,9,7,0,2,0,1,3,1,8,4,0,
     &                          7,2,7,3,8,8,7,2,3,4,3,1/
      DATA (IRND(I,304),I=1,24)/4,4,0,1,4,1,9,5,0,8,3,5,
     &                          9,8,4,5,3,7,3,8,0,2,8,1/

      DATA (IRND(I,305),I=1,24)/0,4,4,1,4,5,4,9,2,5,2,4,
     &                          6,1,5,3,5,3,0,9,1,4,6,4/
      DATA (IRND(I,306),I=1,24)/8,6,5,0,1,5,0,5,0,2,0,7,
     &                          3,6,2,4,6,6,5,3,2,4,9,4/
      DATA (IRND(I,307),I=1,24)/6,2,2,0,6,8,2,4,4,8,5,4,
     &                          7,9,5,6,3,8,8,4,5,0,1,8/
      DATA (IRND(I,308),I=1,24)/3,7,2,6,4,6,9,4,6,0,9,0,
     &                          6,8,4,8,9,9,0,0,2,1,1,2/
      DATA (IRND(I,309),I=1,24)/3,4,3,4,1,5,3,1,9,4,6,9,
     &                          3,0,4,2,2,8,0,3,0,1,2,3/
      DATA (IRND(I,310),I=1,24)/6,5,4,8,9,6,1,6,2,8,2,7,
     &                          1,1,9,8,3,0,9,1,4,9,5,7/
      DATA (IRND(I,311),I=1,24)/4,1,4,4,3,5,3,1,9,3,0,8,
     &                          4,3,4,7,6,9,8,5,1,1,1,4/
      DATA (IRND(I,312),I=1,24)/0,3,1,2,3,6,1,7,2,8,1,2,
     &                          3,1,7,2,2,6,6,6,9,9,7,3/
      DATA (IRND(I,313),I=1,24)/4,6,8,9,5,9,0,5,8,6,5,2,
     &                          7,6,6,4,0,5,5,4,2,4,1,4/
      DATA (IRND(I,314),I=1,24)/6,9,2,2,8,0,7,0,7,8,6,0,
     &                          0,6,0,4,9,5,8,2,0,0,8,2/
      DATA (IRND(I,315),I=1,24)/5,6,5,5,2,5,1,4,5,6,7,4,
     &                          0,1,8,0,2,5,0,0,2,5,0,0/
      DATA (IRND(I,316),I=1,24)/1,4,1,8,6,1,0,3,3,8,8,0,
     &                          2,9,5,6,5,2,2,4,1,5,2,2/
      DATA (IRND(I,317),I=1,24)/1,6,9,5,2,8,7,8,7,3,7,4,
     &                          7,5,9,8,4,1,7,1,3,6,8,2/
      DATA (IRND(I,318),I=1,24)/9,6,1,7,4,2,6,9,1,6,6,3,
     &                          8,4,2,7,6,5,8,7,2,5,5,2/
      DATA (IRND(I,319),I=1,24)/8,2,6,5,7,1,9,6,0,8,2,0,
     &                          1,8,3,0,2,3,0,3,5,2,0,7/
      DATA (IRND(I,320),I=1,24)/7,2,1,3,1,0,3,0,4,8,0,0,
     &                          8,3,0,0,2,6,0,3,9,6,5,6/
      DATA (IRND(I,321),I=1,24)/6,9,7,9,3,7,0,0,9,0,5,0,
     &                          7,0,6,4,2,8,2,1,7,4,3,7/
      DATA (IRND(I,322),I=1,24)/5,9,0,2,0,0,4,6,8,7,9,4,
     &                          2,2,6,1,1,9,0,6,7,2,7,9/
      DATA (IRND(I,323),I=1,24)/1,1,0,9,6,2,1,3,8,0,9,7,
     &                          7,1,9,6,0,6,9,8,0,8,6,2/

      DATA (IRND(I,324),I=1,24)/0,3,6,6,3,0,3,2,4,9,6,6,
     &                          9,0,8,9,7,1,9,6,3,6,8,1/
      DATA (IRND(I,325),I=1,24)/2,7,4,0,2,1,8,3,8,2,2,0,
     &                          8,3,9,6,6,6,2,5,3,6,1,1/
      DATA (IRND(I,326),I=1,24)/2,9,8,2,5,4,6,8,8,7,2,5,
     &                          6,4,5,5,8,7,2,9,4,9,7,8/
      DATA (IRND(I,327),I=1,24)/4,5,9,5,4,6,5,9,5,8,0,7,
     &                          8,6,6,7,2,3,9,1,7,3,0,6/
      DATA (IRND(I,328),I=1,24)/3,8,0,1,5,2,0,1,4,5,5,8,
     &                          3,0,1,2,6,1,1,3,0,9,9,5/
      DATA (IRND(I,329),I=1,24)/9,3,4,5,0,9,5,3,1,4,5,6,
     &                          8,3,7,9,2,8,4,1,9,8,1,5/
      DATA (IRND(I,330),I=1,24)/0,7,8,6,1,0,7,2,7,9,5,5,
     &                          2,6,9,9,8,1,5,7,5,0,0,8/
      DATA (IRND(I,331),I=1,24)/3,3,8,5,3,6,7,6,0,6,9,1,
     &                          2,5,2,8,2,6,9,4,6,9,2,9/
      DATA (IRND(I,332),I=1,24)/8,9,3,1,8,6,1,4,3,5,8,5,
     &                          3,1,4,3,4,9,8,0,3,3,2,0/
      DATA (IRND(I,333),I=1,24)/4,6,0,0,2,9,4,8,7,7,2,8,
     &                          6,1,9,7,7,0,3,1,5,2,2,7/
      DATA (IRND(I,334),I=1,24)/7,6,6,4,2,1,5,8,0,2,0,9,
     &                          2,6,2,0,8,0,0,9,5,8,4,8/
      DATA (IRND(I,335),I=1,24)/9,5,6,8,5,3,9,4,2,8,9,6,
     &                          7,9,0,4,6,3,6,8,8,3,5,8/
      DATA (IRND(I,336),I=1,24)/0,6,5,8,5,1,9,5,2,5,9,8,
     &                          2,8,8,6,3,3,8,2,4,6,7,0/
      DATA (IRND(I,337),I=1,24)/7,7,7,8,1,4,4,8,2,2,3,1,
     &                          0,1,5,0,3,7,4,8,2,7,6,9/
      DATA (IRND(I,338),I=1,24)/3,3,2,0,3,2,4,1,8,5,4,7,
     &                          6,6,1,1,8,1,6,4,2,3,1,2/
      DATA (IRND(I,339),I=1,24)/2,7,8,5,2,7,6,9,6,1,7,6,
     &                          2,4,8,0,2,1,9,5,9,0,0,4/
      DATA (IRND(I,340),I=1,24)/4,8,2,2,8,2,8,0,8,0,6,8,
     &                          5,7,2,2,2,5,6,8,3,7,6,0/
      DATA (IRND(I,341),I=1,24)/0,4,4,0,8,4,9,4,8,1,8,0,
     &                          3,8,8,6,7,5,2,0,0,3,9,1/
      DATA (IRND(I,342),I=1,24)/0,2,4,3,5,7,9,5,6,5,3,0,
     &                          0,9,0,1,0,0,9,6,6,4,2,7/

      DATA (IRND(I,343),I=1,24)/7,6,6,5,8,1,0,3,5,6,4,3,
     &                          5,9,9,7,6,8,8,8,5,9,1,1/
      DATA (IRND(I,344),I=1,24)/8,9,2,1,9,7,6,7,6,0,7,0,
     &                          0,4,9,5,2,5,2,1,4,0,8,8/
      DATA (IRND(I,345),I=1,24)/5,2,4,6,9,4,7,6,3,5,4,4,
     &                          2,5,0,6,1,8,7,8,9,5,9,8/
      DATA (IRND(I,346),I=1,24)/2,1,7,6,9,8,7,7,9,3,5,3,
     &                          2,9,9,9,0,5,2,3,0,9,2,1/
      DATA (IRND(I,347),I=1,24)/3,3,0,1,4,3,0,4,1,0,3,3,
     &                          4,9,6,3,6,7,1,4,3,9,6,9/
      DATA (IRND(I,348),I=1,24)/3,3,2,1,8,2,9,6,2,8,8,1,
     &                          9,9,8,9,5,9,3,3,3,3,7,4/
      DATA (IRND(I,349),I=1,24)/9,3,3,4,4,9,0,9,7,1,1,2,
     &                          5,0,0,2,4,0,7,2,9,8,4,3/
      DATA (IRND(I,350),I=1,24)/3,2,3,7,9,8,3,2,7,8,1,9,
     &                          0,0,7,7,6,3,7,0,6,2,5,9/
      DATA (IRND(I,351),I=1,24)/4,9,7,0,2,0,1,3,1,8,4,0,
     &                          7,2,7,3,8,8,7,2,3,4,3,1/
      DATA (IRND(I,352),I=1,24)/4,4,0,1,4,1,9,5,0,8,3,5,
     &                          9,8,4,5,3,7,3,8,0,2,8,1/
      DATA (IRND(I,353),I=1,24)/0,4,4,1,4,5,4,9,2,5,2,4,
     &                          6,1,5,3,5,3,0,9,1,4,6,4/
      DATA (IRND(I,354),I=1,24)/8,6,5,0,1,5,0,5,0,2,0,7,
     &                          3,6,2,4,6,6,5,3,2,4,9,4/
      DATA (IRND(I,355),I=1,24)/6,2,2,0,6,8,2,4,4,8,5,4,
     &                          7,9,5,6,3,8,8,4,5,0,1,8/
      DATA (IRND(I,356),I=1,24)/3,7,2,6,4,6,9,4,6,0,9,0,
     &                          6,8,4,8,9,9,0,0,2,1,1,2/
      DATA (IRND(I,357),I=1,24)/3,4,3,4,1,5,3,1,9,4,6,9,
     &                          3,0,4,2,2,8,0,3,0,1,2,3/
      DATA (IRND(I,358),I=1,24)/6,5,4,8,9,6,1,6,2,8,2,7,
     &                          1,1,9,8,3,0,9,1,4,9,5,7/
      DATA (IRND(I,359),I=1,24)/4,1,4,4,3,5,3,1,9,3,0,8,
     &                          4,3,4,7,6,9,8,5,1,1,1,4/
      DATA (IRND(I,360),I=1,24)/0,3,1,2,3,6,1,7,2,8,1,2,
     &                          3,1,7,2,2,6,6,6,9,9,7,3/
      DATA (IRND(I,361),I=1,24)/4,6,8,9,5,9,0,5,8,6,5,2,
     &                          7,6,6,4,0,5,5,4,2,4,1,4/

      DATA (IRND(I,362),I=1,24)/6,9,2,2,8,0,7,0,7,8,6,0,
     &                          0,6,0,4,9,5,8,2,0,0,8,2/
      DATA (IRND(I,363),I=1,24)/5,6,5,5,2,5,1,4,5,6,7,4,
     &                          0,1,8,0,2,5,0,0,2,5,0,0/
      DATA (IRND(I,364),I=1,24)/1,4,1,8,6,1,0,3,3,8,8,0,
     &                          2,9,5,6,5,2,2,4,1,5,2,2/
      DATA (IRND(I,365),I=1,24)/1,6,9,5,2,8,7,8,7,3,7,4,
     &                          7,5,9,8,4,1,7,1,3,6,8,2/
      DATA (IRND(I,366),I=1,24)/9,6,1,7,4,2,6,9,1,6,6,3,
     &                          8,4,2,7,6,5,8,7,2,5,5,2/
