C     Include File:  MAIN1.INC

C       WE ANTICIPATE THESE WILL BE USEFUL BOTH
C       IN THE PREPROCESSING AND IN THE MET PROCESSOR

      INTEGER       I,DEVIN,DEVIO,DEV40,DEV50,DEV60,DEV70,DEV80,NKEYWD
      INTEGER       MRDAY1,MRDAY2,MRYR1,MRYR2,MRGDY1,MRGDY2,
     1              MRGMO1,MRGMO2,MAXERR,JBYR1,JBYR2,JBGMO1,
     1              JBGMO2,JBGDY1,JBGDY2,JBDAY1,JBDAY2,JBCDY1,JBCDY2

      CHARACTER*10  KEYWRD
      CHARACTER*48  DISK40,DISK50,DISK60,DISK80
      LOGICAL       BACK40

      PARAMETER (MAXERR=5, NKEYWD=29)

      COMMON /BANK1/ DEVIN,DEVIO,DEV40,DEV50,DEV60,DEV70,DEV80
      COMMON /BANK2/ MRDAY1,MRDAY2,MRYR1,MRYR2,MRGDY1,MRGDY2,
     1               MRGMO1,MRGMO2,JBYR1,JBYR2,JBGMO1,
     1               JBGMO2,JBGDY1,JBGDY2,JBDAY1,JBDAY2,JBCDY1,JBCDY2
      COMMON /BANK3/ BACK40
      COMMON /NAME1/ KEYWRD(6, NKEYWD), NUMKEY(6)
      COMMON /NAME2/ DISK40,DISK50,DISK60,DISK80
      COMMON /VERSN/ IVDATE


C       DEVIN,DEVIO     DEVICE NUMBERS OF STANDARD INPUT AND OUTPUT
C       DEV40           DEVICE NUMBER FOR MERGED DATA
C       DEV50           DEVICE NUMBER FOR GENERAL REPORTS (PRINT)
C       DEV60           DEVICE NUMBER FOR ERRORS  REPORTS (PRINT)
C       DEV70           DEVICE NUMBER FOR TEMPORARY FILE OF HEADERS
C       DEV80           DEVICE NUMBER FOR OUTPUT FROM METPROCESSOR
C Note: the random numbers are now in block data and are not read from a file
C       DEV90           DEVICE NUMBER FOR RANDOM NUMBERS (IF REQUIRED)
C       DISK40          FILENAME FOR DEV40
C       DISK50          FILENAME FOR DEV50
C       DISK60          FILENAME FOR DEV60                        
C       DISK80          FILENAME FOR DEV80
C Note: the random numbers are now in block data and are not read from a file
C       DISK90          FILENAME FOR DEV90 (removed from INCLUDE)       JOPapr95
C       IVDATE          Version Date (I5) YYJJJ Year and Julian Day     DTBJUN93
C       BACK40          LOGICAL INDICATING WHETHER OR NOT TO BACKSPACE
C                       ON UNIT 40 (MACHINE DEPENDENT)
C                       (VAX = FALSE; PC = TRUE)
C       MAXERR          MAXIMUM NUMBER OF READ/DECODE ERRORS ALLOWED 
C                       ON EACH PATHWAY IN EXTRACTING (SOUNDINGS, MIXING
C                       HEIGHTS, SURFACE) OR QA'ING (ONSITE)
C       MRDAY1,MRDAY2   START AND STOP JULIAN DAYS FOR MERGE DATA
C       MRYR1...MRGMO2  START AND STOP DAYS (GREGORIAN) FOR MERGE
C       KEYWRD          KEYWORDS USED TO DEFINE AND CONTROL SETUP
C                       DATA.
C
