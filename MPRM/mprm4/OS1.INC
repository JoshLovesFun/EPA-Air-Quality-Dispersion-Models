C
C***    OS PATHWAY
C
C       WE ANTICIPATE THESE WILL BE USEFUL BOTH
C       IN THE PREPROCESSING AND IN THE MET PROCESSOR
C
      INTEGER   OSMH,OSML,OSMDAT,OSMVEC,OSMRDS,OSMV
      INTEGER   OSNL,OSNDT,OSDNUM
      INTEGER   OSDVAR,OSDCRD
      CHARACTER OSLOC*8,OSLAT*8,OSLON*8,OSFRMT*80
      REAL      OSCALM,OSDT,OSLL,OSUL,OSHT,OSSOBS,OSVOBS
C
      PARAMETER (OSMH=24,OSML=10,OSMDAT=20,OSMVEC=15,OSMRDS=20,OSMV=60)
      COMMON /OSBK01/ OSNL,OSNDT,OSDCRD,
     1                OSDNUM(OSMRDS),
     1                OSDVAR(OSMRDS,OSMDAT,2)
      COMMON /OSBK02/ OSCALM,OSDT(OSMH,3),OSLL(3),OSUL(3),OSHT(OSML),
     1                OSSOBS(OSMH,OSMV),
     1                OSVOBS(OSMH,OSML,OSMVEC)
      COMMON /OSBK03/ OSLON,OSLAT,OSLOC,OSFRMT(OSMRDS)
C
C       OSMRDS          MAXIMUM NUMBER OF 'CARD IMAGES' TO BE PROCESSED
C                       IN ORDER TO READ IN OS-DATA FOR A
C                       PARTICULAR TIME PERIOD.
C       OSMV            SET EQUAL TO SFMV
C       OSCALM          THRESHHOLD VALUE OF WIND SPEED, BELOW WHICH
C                       THE WIND IS CONSIDERED CALM (M/S)
C       OSMH            MAXIMUM NUMBER OF HOURS MERGED
C       OSML            MAXIMUM NUMBER OF LEVELS MERGED
C       OSMDAT          MAXIMUM NUMBER OF VARIABLES READ IN ON ANY
C                       ONE READ (WHILE READING OS DATA OBSERVATIONS)
C       OSMVEC          MAXIMUM NUMBER OF VECTOR WXX VARIABLES 
C                       AT EACH LEVEL FOR EACH HOUR
C       OSNL            NUMBER OF LEVELS FOR THIS SITE
C       OSNDT           NUMBER OF DELTA-T VALUES FOR THIS SITE
C       OSDCRD          NUMBER OF RECORDS REQUIRED TO READ THE OS   
C                       VARIABLES 
C       OSDNUM          NUMBER OF VALUES (FOR EACH LIST OF VARIABLES
C                       READ IN) FOR THIS SITE
C       OSDVAR          VARIABLE INDEX (WITHIN ARRAY VNAMES) IN
C                       SEQUENCE AS THEY ARE LISTED IN QA INPUT AND 
C                       OUTPUT
C                       OSDVAR(OSMRDS,OSMDAT,2) WHERE
C                            1: YIELDS VARIABLE INDEX WITHIN VNAMES
C                            2: IS 0 FOR SCALAR VARIABLES; LEVEL
C                               ON TOWER FOR VECTOR VARIABLES
C       OSDT            DELTA-T VALUES REPORTED
C       OSLL,OSUL       LOWER AND UPPER MEASUREMENT HEIGHTS FOR DELT-T
C                       VALUES
C       OSHT            TOWER MEASURMENT HEIGHTS FOR THIS SITE
C       OSSOBS          SCALAR WXX VARIABLES REPORTED
C       OSVOBS          VECTOR (TOWER) VARIABLES REPORTED
C       OSLON           LONGITUDE*100 (DEGREES) (E.G. 8034E)          
C       OSLAT           LATITUDE*100 (DEGREES) (E.G. 3034N)
C       OSLOC           SITE ID
C       OSFMT           FORMATS FOR READING OS DATA FOR EACH 
C                       TIME PERIOD
C
