C       WE ANTICIPATE THESE WILL BE USEFUL ONLY DURING
C       PREPROCESSING
C
      INTEGER      N,II,DEV31,DEV32,OSDAY1,OSDAY2,OSYR1,OSYR2
      INTEGER      OSGDY1,OSGDY2,OSGMO1,OSGMO2,OSGDY,OSGMO,OSGYR,OSGHR
      INTEGER      OSGMI,OSLDY,OSLMO,OSLYR,OSLHR,OSLMI,OSDAY,OSMO,OSHR
      INTEGER      OSMN,OSYR,OSDAYC,OSAVG,OSMIN,OSLST,OSTIME,OSNWDS
      INTEGER      OSSAUD,OSVAUD,OSAUD1,OSAUD2,OSSTRA
      CHARACTER*48 DISK31,DISK32
      REAL         OSSFC,OSWDS
C
      PARAMETER (MAXFRQ=12, MAXSEC=12, NSITCH=8)

C     These parameters are used to define the site-specific characteristics
C     MAXFRQ  = Maximum number of temporal periods (12=monthly)
C     MAXSEC  = Maximum number of wind direction sectors
C     NSITCH  = Number of direction-specific, time-dependent characteristics

      COMMON /OSBK04/ DEV31,DEV32
      COMMON /OSBK05/ DISK31,DISK32

      COMMON /OSBK06/ OSDAY1,OSYR1,OSGMO1,OSGDY1,
     1                OSDAY2,OSYR2,OSGMO2,OSGDY2,
     1                OSDAYC,OSGYR,OSGMO,OSGDY,OSGHR,OSGMI,
     1                OSLDY,OSLMO,OSLYR,OSLHR,OSLMI,OSLST,OSTIME

      COMMON /OSBK07/ OSVAUD(OSML,OSMVEC),
     1                OSAUD1(OSMV,0:3), OSAUD2(OSML,OSMVEC,0:3),
     1                OSSAUD(OSMV),OSSTRA(OSMV),OSNWDS

      COMMON /OSBK08/ OSYR(OSMH),OSMO(OSMH),OSHR(OSMH),OSMN(OSMH),
     1                OSDAY(OSMH), OSAVG,OSMIN

      COMMON /OSBK09/ OSSFC(MAXFRQ,MAXSEC,NSITCH), OSWDS(12,2)
C
C       DEV31           DEVICE NUMBER OF OS QA INPUT DATA
C       DEV32           DEVICE NUMBER OF OS QA OUTPUT DATA
C       DISK31          FILENAME FOR DEV31
C       DISK32          FILENAME FOR DEV32
C       OSDAY1,OSDAY2   START AND STOP JULIAN DAYS FOR PROCESSING
C       OSDAYC          CURRENT JULIAN DAY BEING PROCESSED
C       OSYR1,OSYR2     START AND STOP YEARS FOR PROCESSING
C       OSGDY1,OSGDY2   START AND STOP DAYS (GREGORIAN)
C       OSGMO1,OSGMO2   START AND STOP MONTHS (GREGORIAN)
C       OSGDY...OSGMI   CURRENT DAY, MONTH, YEAR, HOUR AND MINUTE
C                       BEING PROCESSED
C       OSLDY...OSLMI   LAST DAY, MONTH, YEAR, HOUR AND
C                       MINUTE PROCESSED
C       OSDAY...OSHR    DAY, MONTH, YEAR, AND HOUR FOR
C                       EACH HOUR MERGED
C       OSLST           CONVERSION FACTOR FOR USER TIME TO SOLAR TIME,
C                        SUCH THAT USER TIME - FACTOR = SOLAR TIME
C       OSAVG           NUMBER OF OBSERVATIONS REPORTED EACH HOUR
C       OSMIN           MINIMUM ACCEPTABLE NUMBER OF OBS. TO COMPUTE
C                       ONE HOUR AVERAGES
C                       IF OSAVG(EVEN) THEN OSMIN = OSAVG/2
C                                      ELSE OSMIN = OSAVG/2 + 1
C       OSNWDS          NUMBER OF WIND DIRECTION SECTORS FOR THIS SITE
C       OSSAUD(I)       AUDIT INDICATOR FOR ONSITE VARIABLES (I=1,56 TO
C                        CORRESPOND TO THE SFQA ARRAY SIZE)
C                        0 = NO OUTPUT OF AUDIT RESULTS
C                        1 = OUTPUT AUDIT RESULTS FOR THIS (I) VARIABLE.
C       OSSTRA(I)       TRACE INDICATOR FOR ONSITE VARIABLES (I=1,56 TO
C                        CORRESPOND TO THE SFQA ARRAY SIZE)
C                        0 = NO TRACE OUTPUT
C                        1 = OUTPUT TRACE DATA FOR THIS (I) VARIABLE.
C       OSAUD1(I,J)     AUDIT RESULTS FOR OS-SCALAR VARIABLES
C                        J = 0 QA GOOD COUNTER
C                            1 MISSING COUNTER
C                            2 LOWER BOUND VIOLATION COUNTER
C                            3 UPPER BOUND VIOLATION COUNTER
C       OSVAUD(L,I)     SAME AS OSSAUD EXCEPT FOR OS-VECTOR VARIABLES,
C                        THE SPECIAL DIFFERENCE HERE IS THAT WE
C                        DEFINE THIS ARRAY AFTER THE OS DATA MAP IS
C                        DEFINED.  THUS WE KNOW WHETHER REQUESTED
C                        VECTOR VARIABLE TO BE AUDITED OCCURS AT THIS
C                        LEVEL (L), OR NOT.
C       OSAUD2(L,I,J)   SAME AS OSAUD1 EXCEPT FOR OS-VECTOR VARIABLES
C                        L = LEVEL
C                        I = VARIABLE
C                        J = AUDIT RESULTS (SEE OSAUD1 )
C       OSSFC           MONTHLY ALBEDO, BOWEN RATIO, ROUGHNESS FOR UP
C                       TO 12 WIND SECTORS ABOUT SITE
C                        DEFAULTS ARE ALBEDO 0.25
C                                     BOWEN  0.75
C                              ROUGHNESS(M)  0.15
C                        DISPLACEMENT HT(M)  0.75
C                        NET RADIATION FRAC  0.15
C                        MINIMUM OBUKHOV (M) 2.00
C                        ANTHRO HEAT FLUX    0.00
C       OSTIME          NUMBER OF VALUES USED TO DEFINE THE DATE AND
C                       TIME INFORMATION
C       OSWDS           START AND STOP WIND DIRECTIONS FOR EACH
C                       DEFINED WIND SECTOR
C