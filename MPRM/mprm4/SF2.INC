C  include file: SF2.INC
C
      INTEGER      L,DEV20,DEV21,DEV22,DEV25
      INTEGER      SFDCD
      INTEGER      SFDAY1,SFYR1,SFGMO1,SFGDY1,
     &             SFDAY2,SFYR2,SFGMO2,SFGDY2
      INTEGER      SFGDY,SFGMO,SFGYR,SFGHR,SFDAYC,
     &             SFLDY,SFLMO,SFLYR,SFLHR
      INTEGER      PPTGDY,PPTGMO,PPTGYR,PPTGHR,PPDAYC,
     &             PPTLDY,PPTLMO,PPTLYR,PPTLHR
      INTEGER      SFDAY,SFMO,SFYR,SFHR,SFQA,SFQA1,SFLST
      INTEGER      SFOVR(35)
      INTEGER      SFSAUD, SFAUD, SFAUD1, SFAUD2, OSTSKY, SFSTRA
      CHARACTER*48 UNIT20,DISK21,DISK22,DISK25
      CHARACTER*8  SFLOC1
      CHARACTER*2  SFBLK
C
      COMMON /SFBK05/ DEV20, DEV21, DEV22, DEV25,
     &                UNIT20,DISK21,DISK22,DISK25

      COMMON /SFBK06/ SFBLK,SFLOC1
      COMMON /SFBK07/ SFDCD,SFOVR

      COMMON /SFBK08/ SFDAY1,SFYR1,SFGMO1,SFGDY1,
     &                SFDAY2,SFYR2,SFGMO2,SFGDY2,
     &                SFGDY,SFGMO,SFGYR,SFGHR,SFDAYC,
     &                SFLDY,SFLMO,SFLYR,SFLHR,
     &                PPTGDY,PPTGMO,PPTGYR,PPTGHR,PPDAYC,
     &                PPTLDY,PPTLMO,PPTLYR,PPTLHR

      COMMON /SFBK09/ SFDAY(SFMH), SFMO(SFMH), SFYR(SFMH), SFHR(SFMH),
     &                SFQA(SFMV,4), SFQA1(SFMV,2), SFSAUD(SFHLY),
     &                SFSTRA(SFHLY),  SFAUD(SFHLY,0:3),
     &                SFAUD1(11,0:3), SFAUD2(11,0:3), SFLST,
     &                OSTSKY(4)
C
C       DEV20           DEVICE NUMBER FOR HOURLY WXX OBSERVATION DATA
C       DEV21           DEVICE NUMBER FOR SF QA INPUT DATA
C       DEV22           DEVICE NUMBER FOR SF QA OUTPUT DATA
C       DEV25           DEVICE NUMBER FOR PRECIPITATION DATA (INPUT)
C       UNIT20          FILENAME FOR DEV20 (EXTRACT INPUT)
C       DISK21          FILENAME FOR DEV21 (EXTRACT OUTPUT)
C       DISK22          FILENAME FOR DEV22 (QA OUTPUT)
C       DISK25          FILENAME FOR DEV25 (PRECIPITATION)

C       SFDAY1,SFDAY2   START, STOP CHRONOLOGICAL DAYS FOR SF EXTRACT
C       SFYR1,SFYR2     START AND STOP YEARS FOR EXTRACT DATA
C       SFGDY1,SFGDY2   START AND STOP DAYS (GREGORIAN)
C       SFGMO1,SFGMO2   START AND STOP MONTHS (GREGORIAN)
C       SFGDY...SFGHR   CURRENT OBSERVATION DATE BEING PROCESSED
C       SFDAYC          CURRENT CHRONOLOGICAL DAY BEING PROCESSED
C                        (JULIAN DAY IN MERGE)
C       SFLDY...SFLHR   LAST OBSERVATION DATE PROCESSED
C       PPTGDY..PPTGHR  CURRENT OBSERVATION DATE BEING PROCESSED
C       PPDAYC          CURRENT CHRONOLOGICAL DAY BEING PROCESSED
C                        (JULIAN DAY IN MERGE)
C       PPTLDY..PPTLHR  LAST OBSERVATION DATE PROCESSED

C       SFDCD           FORMAT CODE OF DATA ON TAPE
C       SFBLK           BLOCKING FORMAT ON THE TAPE ('FB' OR 'VB')
C       SFLOC1          STATION ID FOR SURFACE DATA EXTRACTION
C       SFOVR           ARRAY OF OVERPUNCHES FOR SURFACE EXTRACT

C       SFDAY...SFHR    DAY, MONTH, YEAR AND HOUR FOR EACH HOUR MERGED
C       SFQA            LOWER AND UPPER RANGE CHECK BOUNDS FOR WXX
C                       VARIABLES
C       OSTSKY          SAME AS SFQA BUT FOR THE TSKY VARIABLE GIVEN
C                       ON THE OS-PATHWAY.  NOTE, THE ASSUMPTION MADE
C                       IS THAT OSTSKY IS THE TOTAL SKY COVER IN TENTHS
C       SFQA1(I,J)      LEADING (J=1) AND TRAILING(J=2) MISSING VALUE
C                        INDICATORS FOR CONCATENATED VARIABLES
C       SFSAUD(I)       AUDIT VARIABLE INDICATOR
C       SFSTRA(I)       TRACE VARIABLE INDICATOR
C       SFAUD(I,J)      AUDIT RESULTS  FOR SURFACE DATA (I=VBL #),
C                        EXCLUDING CONCATENATED VARIABLES
C                        J = 0 QA GOOD COUNTER
C                            1 MISSING COUNTER
C                            2 LOWER BOUND VIOLATION COUNTER
C                            3 UPPER BOUND VIOLATION COUNTER
C       SFAUD1(I,J)     AUDIT RESULTS (J=0,3) FOR LEADING CONCATENATED
C                        VARIABLE (AUDIT INDICATOR (J=4) IS IN SFAUD)
C       SFAUD2(I,J)     AUDIT RESULTS (J=0,3) FOR TRAILING CONCATENATED
C                        VARIABLE (AUDIT INDICATOR (J=4) IS IN SFAUD)
C       SFLST           CONVERSION FACTOR FOR USER TIME TO SOLAR TIME,'
C                        SUCH THAT USER TIME - FACTOR = SOLAR TIME
