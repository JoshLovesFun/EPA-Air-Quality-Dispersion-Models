C     Include File:  UA1.INC
C
C       WE ANTICIPATE THESE WILL BE USEFUL BOTH
C       IN THE PREPROCESSING AND IN THE MET PROCESSOR
C
      INTEGER     UAMH,UAML,UAMV,UAVR,UAOBS,UABLKF                      DTB94243
      INTEGER     MIXP1,MIXP2,MIXC1,MIXC2,MIXN1,MIXN2
      CHARACTER   UALOC*8,UALON*8,UALAT*8,UAFMT*8,ZIFRMT*80
C
      PARAMETER (UAMH=24,UAMV=6,UAML=20,UAVR=12)
      COMMON /UABK01/ UAOBS(UAMH,UAML,UAMV),
     1                MIXP1,MIXP2,MIXC1,MIXC2,MIXN1,MIXN2
      COMMON /UABK02/ UALOC,UALON,UALAT,UAFMT,ZIFRMT
C
C       UAMH            MAXIMUM NUMBER OF HOURS MERGED
C       UAMV            MAXIMUM NUMBER OF VARIABLES MERGED 
C                       IN SOUNDINGS
C       UAML            MAXIMUM NUMBER OF LEVELS MERGED IN SOUNDINGS
C       UAVR            MAXIMUM NUMBER OF QA VARIABLES (VECTOR+SCALAR)
C       UALOC           UA STATION ID
C       UAOBS           UPPER AIR SOUNDING RESULTS 
C                       (HOUR,LEVEL,VARIABLE)
C       MIXP1...MIXN2   HOLZWORTH ZI VALUES FOR PRECEEDING, CURRENT 
C                       AND NEXT  DAY
C       UALON           LONGITUDE*100 (DEGREES) (E.G. 8015E)
C       UALAT           LATTITUDE*100 (DEGREES) (E.G. 3012N)
C       UAFMT           UA SOUNDING FORMAT (E.G. 5600VB)
C       ZIFRMT          ZI FORMAT (E.G. 9689FB OR USER )
C
C                                                   
