C***    WORK BLOCK
C
C       WE ANTICIPATE THESE WILL BE USEFUL BOTH
C       IN THE PREPROCESSING AND IN THE MET PROCESSOR
C
C
      CHARACTER BLNK01(80)*1,BLNK04*4,BLNK08*8,BLNK40*40,BLNK48*48
      CHARACTER BLNK28*28,BLNK32*32,BLNK80*80
      CHARACTER PATH*2,ECODE*3,LOC*6,MESS*40
      CHARACTER BUF01(80)*1,BUF40*40,BUF80(10)*80,BUFFR1*1,BUFFR2*1
      CHARACTER BUF02*2,BUF03*3,BUF04*4,BUF08*8,BUF32*32,BUF48*48
      CHARACTER BUF28*28
      INTEGER   IRD1,IRD2,IRD3,IRD4,IRD5,IWORK1,IWORK2
      INTEGER   KOUNT, NCHB1, NCHB2, AD1, AD2, AD3
      REAL      XRD1,XRD2,XRD3,WORK1,WORK2
      PARAMETER (NCHB1=8000, NCHB2=4000)
      PARAMETER (AD1=1500, AD2=200, AD3=50)
C
      COMMON /WRK01/ BUFFR1(NCHB1),BUFFR2(NCHB2)
      COMMON /WRK02/ BUF02,BUF03,BUF04(10),BUF08(10),BUF32,BUF40,BUF48
      COMMON /WRK03/ IRD1,IRD2,IRD3,IRD4,IRD5,
     1               IWORK1(AD1),IWORK2(AD2,AD3)
      COMMON /WRK04/ XRD1,XRD2,XRD3,WORK1(AD1),WORK2(AD2,AD3)
C
      EQUIVALENCE (BLNK01,BLNK80)
      EQUIVALENCE (BUF01,BUF80)
C
C       BUF01...BUF32   CHARACTER ARRAYS USED IN PROCESSING AND
C                       WORKING WITH THE DATA
C       IRD1...IWORK2   INTEGER ARRAYS USED IN PROCESSING AND
C                       WORKING WITH THE DATA
C       XRD1...WORK2    READ ARRAYS USED IN PROCESSING AND WORKING
C                       WITH THE DATA
C
C       BLNK1...BLNK80  CHARACTER ARRAYS FILLED WITH BLANKS
C
C       KOUNT,PATH,     ARE USED FOR CONSTRUCTING ERROR MESSAGES
C       ECODE,LOC,      KOUNT = CARD IMAGE COUNT, PATH = PATHWAY ID
C       MESS            ECODE = ERROR CODE, LOC = SUBROUTINE NAME
C                       MESS = MESSAGE
C
        DATA BLNK01/80*' '/
        DATA BLNK04/'    '/
        DATA BLNK08/'        '/
        DATA BLNK28/'                            '/
        DATA BLNK32/'                                '/
        DATA BLNK40/'                                        '/
        DATA BLNK48/'                                                '/
